## ESP32-S3/main/Kconfig.projbuild
```kconfig
menu "FYP radar input"
config FYP_RADAR_UART
    int "Radar UART controller (not UART0)"
    range 1 2
    default 1
config FYP_RADAR_RX
    int "Radar data RX GPIO (verify free on your board)"
    range 4 18
    default 18
config FYP_RADAR_BAUD
    int "Radar data baud rate (8N1)"
    range 115200 1250000
    default 115200
endmenu
```

## ESP32-S3/sdkconfig.defaults
```kconfig
CONFIG_IDF_TARGET="esp32s3"
CONFIG_ESPTOOLPY_FLASHSIZE_16MB=y
CONFIG_ESP_CONSOLE_USB_SERIAL_JTAG=y
CONFIG_LIBC_STDOUT_LINE_ENDING_LF=y
```
